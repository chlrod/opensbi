## platform/fpga/ZeroCore_dual/Kconfig
```kconfig
# SPDX-License-Identifier: BSD-2-Clause

config PLATFORM_ARIANE_FPGA
	bool
	select FDT
	select IPI_MSWI
	select IRQCHIP_PLIC
	select SERIAL_XILINX_UARTLITE
	select TIMER_MTIMER
	default y
```
